AUTOSAR XML (schema 00049)
package /Services/ServiceInterfaces
  service interface RoadScene: major-version=3, minor-version=7
    field SceneSummary: has-getter=true, has-notifier=true, has-setter=false
    methods:
      operation QueryObjects
        arg region: direction=IN
        arg matching_objects: type=matching_objects_16_array, direction=OUT
    events:
      data ObjectBatchUpdated
      data LaneStateChanged
