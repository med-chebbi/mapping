AUTOSAR XML (schema 00049)
package /Services/ServiceInterfaces
  service interface CabinOrchestration: major-version=2, minor-version=4
    field ComfortMode: has-getter=true, has-notifier=true, has-setter=true
    methods:
      operation ApplyComfortPreset
        arg preset: type=preset, direction=IN
    events:
      data ComfortSnapshotChanged
