AUTOSAR XML (schema 00049)
package /RootMachineDesign/HardwareComponents
  4 x machine design:
    brake_control_unit
      ethernet communication controller brake_can_controller
    cabin_experience_unit
      ethernet communication controller cabin_can_controller
    domain_gateway
      ethernet communication controller gateway_chassis_controller
      ethernet communication controller gateway_comfort_controller
      ethernet communication controller gateway_ethernet_controller
    perception_compute
      ethernet communication controller perception_service_controller
